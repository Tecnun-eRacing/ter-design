VERSION ""

NS_ :

BS_:

BU_: ECU COMMANDS

BO_ 256 COMMAND: 1 COMMANDS
 SG_ CMD M : 0|8@1+ (1,0) [0|0] "" Vector__XXX

VAL_ 256 CMD 0 "Beep" ;
